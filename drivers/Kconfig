## drivers/video/arducam/Kconfig
```kconfig
config ARDUCAM
    bool "ArduCam OV2640 Camera"
    default y
    depends on DT_HAS_ARDUCAM_OV2640_ENABLED
    select I2C
    select SPI
    help
        Enable ArduCam OV2640 camera driver

if ARDUCAM

config ARDUCAM_CAPTURE_THREAD_STACK_SIZE
    int "Stack size for the frame capture thread stack"
    default 1024
    help
        Size of the stack used for the internal frame capture thread.

config ARDUCAM_CAPTURE_THREAD_PRIO
    int "Priority for the frame capture thread"
    default 0
    help
        Priority level for the internal frame capture thread.

endif
```

## dts/bindings/video/arducam,ov2640.yaml
```yaml
description: ArduCam OV2640 video sensor

compatible: "arducam,ov2640"

on-bus: spi

include: ["spi-device.yaml"]

properties:
  control-bus:
    type: phandle-array
    specifier-space: size
    required: true
    description: |
      Reference to I2C controller the camera is connected to.

  clock-rate-control:
    type: int
    default: 0x87
    description: |
      Define the value to the Clock Rate Control register. By changing
      the system clock divide ratio and PLL, the frame rate and pixel
      rate will change together.
      Bit[7]    Internal frequency doublers ON/OFF selection.
                0: ON       1: OFF
      Bit[6]    Reserved
      Bit[5:0]  Clock divider.

      CLK = XVCLK /(decimal value of CLKRC[5:0] + 1)
```

## west.yml
```yaml
manifest:
  remotes:
    - name: zephyrproject-rtos
      url-base: https://github.com/zephyrproject-rtos

  projects:
    - name: zephyr
      remote: zephyrproject-rtos
      revision: v4.1.0
      import:
        name-allowlist:
          - cmsis
          - hal_nordic
    - name: tflite-micro
      remote: zephyrproject-rtos
      path: modules/ftlite-micro
      revision: 8d404de73acf7687831e16d88e86e4f73cfddf8e
```
